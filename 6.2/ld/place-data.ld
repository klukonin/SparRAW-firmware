/* Размещение сегментов данных.  Сгенерировано gen_data_tree.py. */
SECTIONS { . = 0x0088a004; .rodata.agc_tbl_004 : { KEEP(*(.rodata.agc_tbl_004)) } }
SECTIONS { . = 0x0088a208; .rodata.agc_tbl_208 : { KEEP(*(.rodata.agc_tbl_208)) } }
SECTIONS { . = 0x0088a608; .rodata.agc_tbl_608 : { KEEP(*(.rodata.agc_tbl_608)) } }
SECTIONS { . = 0x00900000; .rodata.fw_data : { KEEP(*(.rodata.fw_data)) } }
SECTIONS { . = 0x00940000; .rodata.uc_data : { KEEP(*(.rodata.uc_data)) } }
